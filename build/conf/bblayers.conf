## build/conf/bblayers.conf
```bitbake
# POKY_BBLAYERS_CONF_VERSION is increased each time build/conf/bblayers.conf
# changes incompatibly
POKY_BBLAYERS_CONF_VERSION = "2"

BBPATH = "${TOPDIR}"
BBFILES ?= ""

ROS_DISTRO = "eloquent"

BBLAYERS ?= " \
  ../../meta \
  ../../meta-poky \
  ../../meta-openembedded/meta-oe \
  ../../meta-openembedded/meta-networking \
  ../../meta-openembedded/meta-perl \
  ../../meta-openembedded/meta-python \
  ../../meta-ros2 \
  ../../meta-ros-common \
  ../../meta-ros2-eloquent \
  ../../meta-security \
  ../../meta-bbb \
"
```
